## board/davinci/dm368asc/Kconfig
```kconfig
if TARGET_DAVINCI_DM368ASC

config SYS_BOARD
	default "dm368asc"

config SYS_VENDOR
	default "davinci"

config SYS_CONFIG_NAME
	default "davinci_dm368asc"

endif
```

## board/davinci/dm368tubin/Kconfig
```kconfig
if TARGET_DAVINCI_DM368TUBIN

config SYS_BOARD
	default "dm368tubin"

config SYS_VENDOR
	default "davinci"

config SYS_CONFIG_NAME
	default "davinci_dm368tubin"

endif
```
